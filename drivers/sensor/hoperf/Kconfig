## drivers/sensor/hoperf/Kconfig
```kconfig
# Copyright (c) 2025 Tim Schrader <tim.schrader92@gmail.com>
# SPDX-License-Identifier: Apache-2.0

# zephyr-keep-sorted-start
source "drivers/sensor/hoperf/hp206c/Kconfig"
source "drivers/sensor/hoperf/th02/Kconfig"
# zephyr-keep-sorted-stop
```

## drivers/sensor/infineon/tle9104/Kconfig
```kconfig
# Copyright (c) 2024 SILA Embedded Solutions GmbH
# Copyright The Zephyr Project Contributors
# SPDX-License-Identifier: Apache-2.0

config TLE9104_DIAGNOSTICS
	bool "TLE9104-Diagnostics (Infineon) output diagnostics sensor driver"
	default y
	depends on DT_HAS_INFINEON_TLE9104_DIAGNOSTICS_ENABLED
	help
	  Enable driver for the output diagnostics of the power train
	  switch TLE9104.
```

## drivers/sensor/isentek/Kconfig
```kconfig
# Copyright (c) 2025 Tim Schrader <tim.schrader92@gmail.com>
# SPDX-License-Identifier: Apache-2.0

# zephyr-keep-sorted-start
source "drivers/sensor/isentek/ist8310/Kconfig"
# zephyr-keep-sorted-stop
```

## drivers/sensor/ite/ite_vcmp_it8xxx2/Kconfig
```kconfig
# ITE Voltage Comparator driver configuration options

# Copyright (c) 2022 ITE Technology Corporation.
# Copyright The Zephyr Project Contributors
# SPDX-License-Identifier: Apache-2.0

menuconfig VCMP_IT8XXX2
	bool "it8xxx2 (ITE) Voltage Comparator sensor driver"
	default y
	depends on DT_HAS_ITE_IT8XXX2_VCMP_ENABLED
	depends on SOC_IT8XXX2 && ADC_ITE_IT8XXX2
	help
	  This option enables the ITE it8xxx2 voltage comparator,
	  it8xxx2 supports six 10-bit resolution voltage comparator
	  channels, and the input of each comparator comes from ADC pin.

if VCMP_IT8XXX2

config VCMP_IT8XXX2_INIT_PRIORITY
	int "Init priority"
	default SENSOR_INIT_PRIORITY
	help
	  This option sets ITE voltage comparator device instance init priority.

config VCMP_IT8XXX2_WORKQUEUE
	bool "Threshold detection uses internal work queue"
	help
	  Threshold detection ISR utilizes system work queue for calling
	  trigger handlers; set this option to use dedicated work queue instead.

if VCMP_IT8XXX2_WORKQUEUE

config VCMP_IT8XXX2_WORKQUEUE_PRIORITY
	int "Threshold detection work queue priority"
	default SYSTEM_WORKQUEUE_PRIORITY
	help
	  This option sets internal ITE voltage comparator threshold detection
	  workqueue priority.

config VCMP_IT8XXX2_WORKQUEUE_STACK_SIZE
	int "Threshold detection work queue stack size"
	default 768
	help
	  This option sets internal ITE voltage comparator threshold detection
	  workqueue stack size.

endif # VCMP_IT8XXX2_WORKQUEUE

endif # VCMP_IT8XXX2
```

## drivers/sensor/liteon/ltr329/Kconfig
```kconfig
# Lite-On LTR-329 light sensor driver configuration

# Copyright (c) 2025 Konrad Sikora
# Copyright The Zephyr Project Contributors
# SPDX-License-Identifier: Apache-2.0

config LTR329
	bool "LTR-329 (LiteOn) ambient light sensor driver"
	default y
	depends on DT_HAS_LITEON_LTR329_ENABLED
	select I2C
	help
	  Enable driver for Lite-On LTR-329 ambient light sensor.
```

## drivers/sensor/liteon/ltrf216a/Kconfig
```kconfig
# LTR-F216A light sensor configuration options

# Copyright (c) 2023 Tridonic
# Copyright The Zephyr Project Contributors
# SPDX-License-Identifier: Apache-2.0

config LTR_F216A
	bool "LTR-F216A (LiteOn) light sensor driver"
	default y
	depends on DT_HAS_LITEON_LTRF216A_ENABLED
	select I2C
	help
	  Enable driver for LiteOn LTR-F216A light sensors.
```

## drivers/sensor/maxbotix/mb7040/Kconfig
```kconfig
#MB7040 ultrasonic sensor config

#Copyright 2025 Sabrina Simkhovich <sabrinasimkhovich @gmail.com>
#SPDX-License-Identifier: Apache-2.0

menuconfig MB7040
	bool "MB7040 (MaxBotix) ultrasonic distance sensor driver"
	default y
	depends on DT_HAS_MAXBOTIX_MB7040_ENABLED
	select I2C
	help
	  Enable driver for MB7040 distance sensor.

config MB7040_DELAY_MS
	int "Delay in milliseconds to wait for distance measurements"
	default 100
	depends on MB7040
	help
	  Timeout for sample fetch.
```

## drivers/sensor/maxim/max17055/Kconfig
```kconfig
# Copyright 2020 Google LLC
# Copyright The Zephyr Project Contributors
#
# SPDX-License-Identifier: Apache-2.0

config MAX17055
	bool "MAX17055 (Maxim) fuel gauge sensor driver"
	default y
	depends on DT_HAS_MAXIM_MAX17055_ENABLED
	select I2C
	help
	  Enable I2C-based driver for MAX17055 Fuel Gauge. This driver supports
	  reading various sensor settings including charge level percentage,
	  time to full/empty, design voltage, temperature and remaining
	  capacity in mA.
```

## drivers/sensor/maxim/max31790/Kconfig
```kconfig
# Copyright (c) 2024 SILA Embedded Solutions GmbH
# Copyright The Zephyr Project Contributors
# SPDX-License-Identifier: Apache-2.0

menu "MAX31790 (Maxim) fan sensor driver"
	depends on DT_HAS_MAXIM_MAX31790_FAN_SPEED_ENABLED || DT_HAS_MAXIM_MAX31790_FAN_FAULT_ENABLED

config MAX31790_SENSOR
	bool
	default y
	depends on MAX31790_FAN_SPEED || MAX31790_FAN_FAULT
	help
	  Enable sensors for the MAX31790 PWM controller.

config MAX31790_FAN_SPEED
	bool "MAX31790 fan speed sensor"
	default y
	depends on DT_HAS_MAXIM_MAX31790_FAN_SPEED_ENABLED
	select MFD
	help
	  Enable driver for the MAX31790 fan speed sensor.

config MAX31790_FAN_FAULT
	bool "MAX31790 fan fault sensor"
	default y
	depends on DT_HAS_MAXIM_MAX31790_FAN_FAULT_ENABLED
	select MFD
	help
	  Enable driver for the MAX31790 fan fault sensor.

endmenu
```

## drivers/sensor/maxim/max31855/Kconfig
```kconfig
# MAX31855 cold-junction compensated thermocouple-to-digital converter configuration options

# Copyright (c) 2020 Christian Hirsch
# Copyright The Zephyr Project Contributors
# SPDX-License-Identifier: Apache-2.0

config MAX31855
	bool "MAX31855 (Maxim) thermocouple sensor driver"
	default y
	depends on DT_HAS_MAXIM_MAX31855_ENABLED
	select SPI
	help
	  Enable driver for MAX31855 SPI-based Cold-Junction Compensated thermocouple-to-Digital Converter.
```

## drivers/sensor/maxim/max6675/Kconfig
```kconfig
# Copyright (c) 2021 Teslabs Engineering S.L.
# Copyright The Zephyr Project Contributors
# SPDX-License-Identifier: Apache-2.0

config MAX6675
	bool "MAX6675 (Maxim) K-thermocouple sensor driver"
	default y
	depends on DT_HAS_MAXIM_MAX6675_ENABLED
	select SPI
	help
	  Enable MAX6675 cold-junction-compensated K-thermocouple to digital
	  converter.
```

## drivers/sensor/melexis/mlx90394/Kconfig
```kconfig
# Copyright (c) 2024 Florian Weber <Florian.Weber@live.de>
# Copyright The Zephyr Project Contributors
# SPDX-License-Identifier: Apache-2.0


config MLX90394
	bool "MLX90394 (Melexis) magnetometer sensor driver"
	default y
	depends on DT_HAS_MELEXIS_MLX90394_ENABLED
	select I2C
	help
	  Enable driver for MLX90394 magnetometer.
```

## drivers/sensor/microchip/mcp970x/Kconfig
```kconfig
# Microchip MCP970X ADC driver
#
# Copyright (c) 2023 FTP Technologies
# Copyright The Zephyr Project Contributors
#
# SPDX-License-Identifier: Apache-2.0

config MCP970X
	bool "MCP9700/9700A, MCP9701/9701A (Microchip) temperature sensor driver"
	default y
	depends on DT_HAS_MICROCHIP_MCP970X_ENABLED
	select ADC
	help
	  Enables Low-Power Linear Active Thermistor IC driver.
```

## drivers/sensor/nordic/npm2100_vbat/Kconfig
```kconfig
# Copyright (c) 2024 Nordic Semiconductor ASA
# Copyright The Zephyr Project Contributors
#
# SPDX-License-Identifier: Apache-2.0

config NPM2100_VBAT
	bool "NPM2100 (Nordic) battery voltage sensor driver"
	default y
	depends on DT_HAS_NORDIC_NPM2100_VBAT_ENABLED
	select I2C
	select MFD
	help
	  Enable NPM2100 battery voltage driver.
```

## drivers/sensor/nuvoton/nuvoton_tach_npcx/Kconfig
```kconfig
# NPCX tachometer sensor configuration options

# Copyright (c) 2021 Nuvoton Technology Corporation.
# Copyright The Zephyr Project Contributors
# SPDX-License-Identifier: Apache-2.0

config TACH_NPCX
	bool "NPCX-Tach (Nuvoton) tachometer sensor driver"
	default y
	depends on DT_HAS_NUVOTON_NPCX_TACH_ENABLED
	depends on SOC_FAMILY_NPCX
	select PINCTRL
	help
	  Enable the "Nuvoton NPCX tachometer sensor.
```

## drivers/sensor/nxp/mcux_acmp/Kconfig
```kconfig
# NXP MCUX analog comparator (ACMP) configuration options

# Copyright (c) 2020 Vestas Wind Systems A/S
# Copyright 2024 NXP
# Copyright The Zephyr Project Contributors
# SPDX-License-Identifier: Apache-2.0

menuconfig SENSOR_MCUX_ACMP
	bool "MCUX-ACMP (NXP) analog comparator sensor driver"
	default y
	depends on DT_HAS_NXP_KINETIS_ACMP_ENABLED
	select PINCTRL
	help
	  Enable driver for the NXP MCUX Analog Comparator (ACMP).

config SENSOR_MCUX_ACMP_TRIGGER
	bool "Trigger support"
	depends on SENSOR_MCUX_ACMP
	help
	  Enable trigger support for the NXP MCUX Analog Comparator
	  (ACMP).
```

## drivers/sensor/nxp/mcux_lpcmp/Kconfig
```kconfig
# NXP MCUX low power comparator (LPCMP) configuration options

# Copyright 2024 NXP
# Copyright The Zephyr Project Contributors
# SPDX-License-Identifier: Apache-2.0

menuconfig MCUX_LPCMP
	bool "MCUX-LPCMP (NXP) low power comparator sensor driver"
	default y
	depends on DT_HAS_NXP_LPCMP_ENABLED
	select PINCTRL
	help
	  Enable the MCUX LPCMP driver.

config MCUX_LPCMP_TRIGGER
	bool "Trigger support"
	depends on MCUX_LPCMP
	help
	  Enable trigger support for the NXP LPCMP.
```

## drivers/sensor/nxp/nxp_lpadc_temp40/Kconfig
```kconfig
# NXP LPADC_TEMP40 temperature sensor configuration options

# Copyright 2025 NXP
# Copyright The Zephyr Project Contributors
# SPDX-License-Identifier: Apache-2.0

config LPADC_TEMP40
	bool "LPADC-TEMP40 (NXP) temperature sensor driver"
	default y
	depends on DT_HAS_NXP_LPADC_TEMP40_ENABLED
	select ADC
	help
	  Enable driver for NXP LPADC_TEMP40 temperature sensor.
```

## drivers/sensor/nxp/nxp_tempmon/Kconfig
```kconfig
# NXP temperature monitor (TEMPMON)

# Copyright (c) 2023 Centralp
# Copyright The Zephyr Project Contributors
# SPDX-License-Identifier: Apache-2.0

config NXP_TEMPMON
	bool "NXP Tempmon (NXP) temperature monitor sensor driver"
	default y
	depends on DT_HAS_NXP_TEMPMON_ENABLED
	help
	  Enable driver for the NXP temperature monitor (TEMPMON).
	  This is used to retrieve on-die operational temperature.
```

## drivers/sensor/nxp/qdec_mcux/Kconfig
```kconfig
# Copyright (c) 2022, Prevas A/S
# Copyright The Zephyr Project Contributors
# SPDX-License-Identifier: Apache-2.0

config QDEC_MCUX
	bool "MCUX-QDEC (NXP) quadrature encoder sensor driver"
	default y
	depends on DT_HAS_NXP_MCUX_QDEC_ENABLED
	select MCUX_XBARA
	select PINCTRL
	help
	  Enable support for NXP MCUX Quadrature Encoder driver.
```

## drivers/sensor/nxp/qdec_nxp_s32/Kconfig
```kconfig
# Copyright 2023 NXP
# Copyright The Zephyr Project Contributors
# SPDX-License-Identifier: Apache-2.0

config QDEC_NXP_S32
	bool "S32-QDEC (NXP) quadrature decoder sensor driver"
	default y
	depends on DT_HAS_NXP_QDEC_S32_ENABLED
	select NXP_S32_EMIOS
	select PINCTRL
	help
	  Enable drivers for NXP S32 QUADRATURE DECODER
```

## drivers/sensor/nxp/qdec_tpm/Kconfig
```kconfig
# Copyright 2025 NXP
# Copyright The Zephyr Project Contributors
# SPDX-License-Identifier: Apache-2.0

config QDEC_TPM
	bool "TPM-QDEC (NXP) quadrature decoder sensor driver"
	default y
	depends on DT_HAS_NXP_TPM_QDEC_ENABLED
	select PINCTRL
	help
	  Enable drivers for NXP TPM QUADRATURE DECODER
```

## drivers/sensor/pixart/paa3905/Kconfig
```kconfig
# Copyright (c) 2025 Croxel Inc.
# Copyright (c) 2025 CogniPilot Foundation
# Copyright The Zephyr Project Contributors
# SPDX-License-Identifier: Apache-2.0

menuconfig PAA3905
	bool "PAA3905 (Pixart) optical flow sensor driver"
	default y
	depends on DT_HAS_PIXART_PAA3905_ENABLED
	select SPI
	select SPI_RTIO
	select SENSOR_ASYNC_API
	help
	  Enable driver for PAA3905 Optical Flow sensor.

if PAA3905

config PAA3905_STREAM
	bool "Streaming mode"
	depends on $(dt_compat_any_has_prop,$(DT_COMPAT_PIXART_PAA3905),int-gpios)
	select RTIO_WORKQ
	help
	  Enable streaming mode for the PAA3905 sensor.

endif # PAA3905
```

## drivers/sensor/pixart/pat9136/Kconfig
```kconfig
# Copyright (c) 2025 Croxel Inc.
# Copyright (c) 2025 CogniPilot Foundation
# Copyright The Zephyr Project Contributors
# SPDX-License-Identifier: Apache-2.0

menuconfig PAT9136
	bool "PAT9136 (Pixart) optical flow sensor driver"
	default y
	depends on DT_HAS_PIXART_PAT9136_ENABLED
	select SPI
	select SPI_RTIO
	select RTIO_WORKQ
	select SENSOR_ASYNC_API
	help
	  Enable driver for PAT9136 Optical Flow sensor.

if PAT9136

config PAT9136_STREAM
	bool "Streaming mode"
	depends on $(dt_compat_any_has_prop,$(DT_COMPAT_PIXART_PAT9136),int-gpios)
	help
	  Enable streaming mode for the PAT9136 sensor.

endif # PAT9136
```

## drivers/sensor/pni/rm3100/Kconfig
```kconfig
# Copyright (c) 2025 Croxel, Inc.
# Copyright (c) 2025 CogniPilot Foundation
# Copyright The Zephyr Project Contributors
# SPDX-License-Identifier: Apache-2.0

menuconfig RM3100
	bool "RM3100 (PNI) 3-axis magnetometer sensor driver"
	default y
	depends on DT_HAS_PNI_RM3100_ENABLED
	select I2C
	select I2C_RTIO
	select SENSOR_ASYNC_API
	help
	  Enable driver for PNI RM3100 high-accuracy 3-axis magnetometer.

if RM3100

config RM3100_STREAM
	bool "RM3100 Streaming Mode"
	depends on $(dt_compat_any_has_prop,$(DT_COMPAT_PNI_RM3100),int-gpios)
	help
	  Enable streaming mode for the RM3100 sensor.
	  This mode allows for continuous data output at a specified rate.

endif # RM3100
```
