## drivers/sensor/Kconfig
```kconfig
# Sensor configuration options

# Copyright (c) 2016 Intel Corporation
# Copyright (c) 2024 Croxel Inc
# Copyright The Zephyr Project Contributors
# SPDX-License-Identifier: Apache-2.0

menuconfig SENSOR
	bool "Sensor Drivers"
	help
	  Include sensor drivers in system config

if SENSOR

module = SENSOR
module-str = sensor
source "subsys/logging/Kconfig.template.log_config"

source "drivers/sensor/Kconfig.sensor"
source "drivers/sensor/Kconfig.sensor_clock"

comment "Device Drivers"

# zephyr-keep-sorted-start
source "drivers/sensor/adi/Kconfig"
source "drivers/sensor/amd/Kconfig"
source "drivers/sensor/ams/Kconfig"
source "drivers/sensor/aosong/Kconfig"
source "drivers/sensor/ap/Kconfig"
source "drivers/sensor/asahi_kasei/Kconfig"
source "drivers/sensor/atmel/Kconfig"
source "drivers/sensor/avago/Kconfig"
source "drivers/sensor/bosch/Kconfig"
source "drivers/sensor/broadcom/Kconfig"
source "drivers/sensor/dfrobot/Kconfig"
source "drivers/sensor/ene/Kconfig"
source "drivers/sensor/espressif/Kconfig"
source "drivers/sensor/everlight/Kconfig"
source "drivers/sensor/festo/Kconfig"
source "drivers/sensor/fintek/Kconfig"
source "drivers/sensor/generic/Kconfig"
source "drivers/sensor/gss/Kconfig"
source "drivers/sensor/hamamatsu/Kconfig"
source "drivers/sensor/honeywell/Kconfig"
source "drivers/sensor/hoperf/Kconfig"
source "drivers/sensor/hzgrow/Kconfig"
source "drivers/sensor/infineon/Kconfig"
source "drivers/sensor/isentek/Kconfig"
source "drivers/sensor/ist/Kconfig"
source "drivers/sensor/ite/Kconfig"
source "drivers/sensor/jedec/Kconfig"
source "drivers/sensor/liteon/Kconfig"
source "drivers/sensor/maxbotix/Kconfig"
source "drivers/sensor/maxim/Kconfig"
source "drivers/sensor/meas/Kconfig"
source "drivers/sensor/melexis/Kconfig"
source "drivers/sensor/memsic/Kconfig"
source "drivers/sensor/microchip/Kconfig"
source "drivers/sensor/nordic/Kconfig"
source "drivers/sensor/nuvoton/Kconfig"
source "drivers/sensor/nxp/Kconfig"
source "drivers/sensor/onsemi/Kconfig"
source "drivers/sensor/panasonic/Kconfig"
source "drivers/sensor/peacefair/Kconfig"
source "drivers/sensor/phosense/Kconfig"
source "drivers/sensor/pixart/Kconfig"
source "drivers/sensor/plantower/Kconfig"
source "drivers/sensor/pni/Kconfig"
source "drivers/sensor/raspberrypi/Kconfig"
source "drivers/sensor/realtek/Kconfig"
source "drivers/sensor/renesas/Kconfig"
source "drivers/sensor/rohm/Kconfig"
source "drivers/sensor/sbs/Kconfig"
source "drivers/sensor/sciosense/Kconfig"
source "drivers/sensor/seeed/Kconfig"
source "drivers/sensor/semtech/Kconfig"
source "drivers/sensor/sensirion/Kconfig"
source "drivers/sensor/silabs/Kconfig"
source "drivers/sensor/st/Kconfig"
source "drivers/sensor/tdk/Kconfig"
source "drivers/sensor/ti/Kconfig"
source "drivers/sensor/vishay/Kconfig"
source "drivers/sensor/winsen/Kconfig"
source "drivers/sensor/wsen/Kconfig"
# zephyr-keep-sorted-stop

endif # SENSOR
```

## drivers/sensor/adi/adltc2990/Kconfig
```kconfig
# ADLTC2990 Quad I2C Voltage, Current and Temperature sensor configuration options

# Copyright(c) 2023 Carl Zeiss Meditec AG
# Copyright The Zephyr Project Contributors
# SPDX-License-Identifier: Apache-2.0

menuconfig ADI_ADLTC2990
	bool "ADLTC2990 (ADI) voltage/current/temp sensor driver"
	default y
	depends on DT_HAS_ADI_ADLTC2990_ENABLED
	select I2C
	help
	  Enable the driver for Analog Devices LTC2990
	  Quad I2C Voltage, Current and Temperature Monitor.

if ADI_ADLTC2990

config EMUL_ADI_ADLTC2990
	bool "Emulator for ADLTC2990"
	default y
	depends on EMUL
	help
	  Enable ADLTC2990 emulator.

endif # ADI_ADLTC2990
```

## drivers/sensor/adi/adt7310/Kconfig
```kconfig
# ADT7310 temperature sensor configuration options

# Copyright (c) 2023 Andriy Gelman
# Copyright The Zephyr Project Contributors
# SPDX-License-Identifier: Apache-2.0

menuconfig ADI_ADT7310
	bool "ADT7310 (ADI) temperature sensor driver"
	default y
	depends on DT_HAS_ADI_ADT7310_ENABLED
	select SPI
	help
	  Enable the driver for Analog Devices ADT7310 High-Accuracy
	  16-bit Digital SPI Temperature Sensors.

if ADI_ADT7310

config ADI_ADT7310_TRIGGER
	bool
	depends on GPIO

choice
	prompt "Sets trigger mode"
	default ADI_ADT7310_TRIGGER_NONE
	help
	  Sets thread type for the interrupt handler.

config ADI_ADT7310_TRIGGER_NONE
	bool "No trigger"

config ADI_ADT7310_TRIGGER_GLOBAL_THREAD
	bool "Use global thread"
	depends on GPIO
	depends on $(dt_compat_any_has_prop,$(DT_COMPAT_ADI_ADT7310),int-gpios)
	select ADI_ADT7310_TRIGGER
	help
	  Use a global thread for the interrupt handler.

config ADI_ADT7310_TRIGGER_OWN_THREAD
	bool "Use own thread"
	depends on GPIO
	depends on $(dt_compat_any_has_prop,$(DT_COMPAT_ADI_ADT7310),int-gpios)
	select ADI_ADT7310_TRIGGER
	help
	  Use a separate thread for the interrupt handler.

endchoice

if ADI_ADT7310_TRIGGER_OWN_THREAD

config ADI_ADT7310_THREAD_PRIORITY
	int "Thread priority of the interrupt handler"
	default 1
	help
	  Thread priority of the interrupt handler. A higher number implies a
	  higher priority. The thread is cooperative and will not be interrupted by
	  another thread until execution is released.

config ADI_ADT7310_THREAD_STACK_SIZE
	int "Stack size of the interrupt handler thread"
	default 1024
	help
	  Stack size of the interrupt handler thread.

endif # ADI_ADT7310_TRIGGER_OWN_THREAD

endif # ADI_ADT7310
```

## drivers/sensor/adi/adt7420/Kconfig
```kconfig
# ADT7420 temperature sensor configuration options

# Copyright (c) 2018 Analog Devices Inc.
# Copyright The Zephyr Project Contributors
# SPDX-License-Identifier: Apache-2.0

menuconfig ADI_ADT7420
	bool "ADT7420 (ADI) temperature sensor driver"
	default y
	depends on DT_HAS_ADI_ADT7420_ENABLED
	select I2C
	help
	  Enable the driver for Analog Devices ADT7420 High-Accuracy
	  16-bit Digital I2C Temperature Sensors.

if ADI_ADT7420

config ADI_ADT7420_TEMP_HYST
	int "Temperature hysteresis in °C"
	range 0 15
	default 5
	help
	  Specify the temperature hysteresis in °C for the THIGH, TLOW,
	  and TCRIT temperature limits.

config ADI_ADT7420_TEMP_CRIT
	int "Critical overtemperature in °C"
	range -40 150
	default 147
	help
	  The critical overtemperature pin asserts when the temperature
	  exceeds this value. The default value of 147 is the reset default
	  of the ADT7420.

choice
	prompt "Trigger mode"
	default ADI_ADT7420_TRIGGER_NONE
	help
	  Specify the type of triggering used by the driver.

config ADI_ADT7420_TRIGGER_NONE
	bool "No trigger"

config ADI_ADT7420_TRIGGER_GLOBAL_THREAD
	bool "Use global thread"
	depends on GPIO
	depends on $(dt_compat_any_has_prop,$(DT_COMPAT_ADI_ADT7420),int-gpios)
	select ADI_ADT7420_TRIGGER

config ADI_ADT7420_TRIGGER_OWN_THREAD
	bool "Use own thread"
	depends on GPIO
	depends on $(dt_compat_any_has_prop,$(DT_COMPAT_ADI_ADT7420),int-gpios)
	select ADI_ADT7420_TRIGGER

endchoice

config ADI_ADT7420_TRIGGER
	bool

config ADI_ADT7420_THREAD_PRIORITY
	int "Thread priority"
	depends on ADI_ADT7420_TRIGGER_OWN_THREAD && ADI_ADT7420_TRIGGER
	default 10
	help
	  Priority of thread used by the driver to handle interrupts.

config ADI_ADT7420_THREAD_STACK_SIZE
	int "Thread stack size"
	depends on ADI_ADT7420_TRIGGER_OWN_THREAD && ADI_ADT7420_TRIGGER
	default 1024
	help
	  Stack size of thread used by the driver to handle interrupts.

endif # ADI_ADT7420
```

## drivers/sensor/adi/adxl345/Kconfig
```kconfig
# ADXL345, 3-Axis, +/-16g Digital Accelerometer

# Copyright (c) 2020 Antmicro <www.antmicro.com>
# Copyright The Zephyr Project Contributors
# SPDX-License-Identifier: Apache-2.0

menuconfig ADI_ADXL345
	bool "ADXL345 (ADI) accelerometer sensor driver"
	default y
	depends on DT_HAS_ADI_ADXL345_ENABLED
	select I2C if $(dt_compat_on_bus,$(DT_COMPAT_ADI_ADXL345),i2c)
	select SPI if $(dt_compat_on_bus,$(DT_COMPAT_ADI_ADXL345),spi)
	select RTIO_WORKQ if SENSOR_ASYNC_API
	help
	  Enable driver for ADXL345 Three-Axis Digital Accelerometer.

if ADI_ADXL345

choice ADXL345_TRIGGER_MODE
	prompt "Trigger mode"
	default ADI_ADXL345_TRIGGER_NONE
	help
	  Specify the type of triggering used by the driver.

config ADI_ADXL345_TRIGGER_NONE
	bool "No trigger"

config ADI_ADXL345_TRIGGER_GLOBAL_THREAD
	bool "Use global thread"
	depends on GPIO
	select ADI_ADXL345_TRIGGER

config ADI_ADXL345_TRIGGER_OWN_THREAD
	bool "Use own thread"
	depends on GPIO
	select ADI_ADXL345_TRIGGER

endchoice

config ADI_ADXL345_STREAM
	bool "Use FIFO to stream data"
	select ADI_ADXL345_TRIGGER
	depends on (SPI_RTIO || I2C_RTIO)
	depends on SENSOR_ASYNC_API
	help
	  Use this configuration option to enable streaming sensor data via RTIO.

config ADI_ADXL345_TRIGGER
	bool

config ADI_ADXL345_THREAD_PRIORITY
	int "Thread priority"
	depends on ADI_ADXL345_TRIGGER_OWN_THREAD && ADI_ADXL345_TRIGGER
	default 10
	help
	  Priority of thread used by the driver to handle interrupts.

config ADI_ADXL345_THREAD_STACK_SIZE
	int "Thread stack size"
	depends on ADI_ADXL345_TRIGGER_OWN_THREAD && ADI_ADXL345_TRIGGER
	default 1024
	help
	  Stack size of thread used by the driver to handle interrupts.

endif # ADI_ADXL345
```

## drivers/sensor/adi/adxl372/Kconfig
```kconfig
# Micropower, 3-Axis, +/-200g Digital Accelerometer

# Copyright (c) 2018 Analog Devices Inc.
# Copyright The Zephyr Project Contributors
# SPDX-License-Identifier: Apache-2.0

menuconfig ADI_ADXL372
	bool "ADXL372 (ADI) accelerometer sensor driver"
	default y
	depends on DT_HAS_ADI_ADXL372_ENABLED
	select I2C if $(dt_compat_on_bus,$(DT_COMPAT_ADI_ADXL372),i2c)
	select SPI if $(dt_compat_on_bus,$(DT_COMPAT_ADI_ADXL372),spi)
	select RTIO_WORKQ if SENSOR_ASYNC_API
	help
	  Enable driver for ADXL372 Three-Axis Digital Accelerometers.

if ADI_ADXL372

choice ADI_ADXL372_OP_MODE
	prompt "Operating mode"
	default ADI_ADXL372_PEAK_DETECT_MODE

config ADI_ADXL372_PEAK_DETECT_MODE
	bool "Max Peak detect mode"
	help
	  In most high-g applications, a single (3-axis) acceleration sample at
	  the peak of an impact event contains sufficient information
	  about the event, and the full acceleration history is not required.
	  In this mode the device returns only the over threshold
	  Peak Acceleration between two consecutive sample fetches.

config ADI_ADXL372_MEASUREMENT_MODE
	bool "Measurement Mode"
	help
	  In this mode, acceleration data is provided continuously at the
	  output data rate (ODR).

endchoice

config ADI_ADXL372_ACTIVITY_THRESHOLD
	int "Activity threshold in mg"
	range 0 200000
	default 500
	help
	  Threshold for activity detection.

config ADI_ADXL372_INACTIVITY_THRESHOLD
	int "In-activity threshold in mg"
	range 0 200000
	default 400
	help
	  Threshold for in-activity detection.

config ADI_ADXL372_ACTIVITY_TIME
	int "Activity time"
	range 0 $(UINT8_MAX)
	default 1
	help
	  The activity timer implements a robust activity detection that
	  minimizes false positive motion triggers. When the timer is used,
	  only sustained motion can trigger activity detection.
	  Number of multiples of 3.3 ms activity timer for which above threshold
	  acceleration is required to detect activity. It is 3.3 ms per code
	  for 6400 Hz ODR, and it is 6.6 ms per code for 3200 Hz ODR and below.

config ADI_ADXL372_INACTIVITY_TIME
	int "In-activity time"
	range 0 $(UINT8_MAX)
	default 2
	help
	  The time that all enabled axes must be lower than the inactivity
	  threshold for an inactivity event to be detected. Number of multiples
	  of 26 ms inactivity timer for which below threshold acceleration is
	  required to detect inactivity. It is 26 ms per code for 3200 Hz ODR
	  and below, and it is 13 ms per code for 6400 Hz ODR.

config ADI_ADXL372_REFERENCED_ACTIVITY_DETECTION_MODE
	bool "Use referenced activity/in-activity detection"
	default y
	help
	  Activity detection can be configured as referenced or absolute.
	  When using absolute activity detection, acceleration samples are
	  compared directly to a user set threshold to determine whether
	  motion is present. In many applications, it is advantageous for
	  activity detection to be based not on an absolute threshold,
	  but on a deviation from a reference point or orientation.

choice ADI_ADXL372_TRIGGER_MODE
	prompt "Trigger mode"
	default ADI_ADXL372_TRIGGER_NONE
	help
	  Specify the type of triggering used by the driver.

config ADI_ADXL372_TRIGGER_NONE
	bool "No trigger"

config ADI_ADXL372_TRIGGER_GLOBAL_THREAD
	bool "Use global thread"
	depends on GPIO
	depends on $(dt_compat_any_has_prop,$(DT_COMPAT_ADI_ADXL372),int1-gpios)
	select ADI_ADXL372_TRIGGER

config ADI_ADXL372_TRIGGER_OWN_THREAD
	bool "Use own thread"
	depends on GPIO
	depends on $(dt_compat_any_has_prop,$(DT_COMPAT_ADI_ADXL372),int1-gpios)
	select ADI_ADXL372_TRIGGER

endchoice

config ADI_ADXL372_STREAM
	bool "Use FIFO to stream data"
	select ADI_ADXL372_TRIGGER
	default y
	depends on SPI_RTIO
	depends on SENSOR_ASYNC_API
	help
	  Use this configuration option to enable streaming sensor data via RTIO.

config ADI_ADXL372_TRIGGER
	bool

config ADI_ADXL372_THREAD_PRIORITY
	int "Thread priority"
	depends on ADI_ADXL372_TRIGGER_OWN_THREAD && ADI_ADXL372_TRIGGER
	default 10
	help
	  Priority of thread used by the driver to handle interrupts.

config ADI_ADXL372_THREAD_STACK_SIZE
	int "Thread stack size"
	depends on ADI_ADXL372_TRIGGER_OWN_THREAD && ADI_ADXL372_TRIGGER
	default 1024
	help
	  Stack size of thread used by the driver to handle interrupts.

endif # ADI_ADXL372
```

## drivers/sensor/amd/Kconfig
```kconfig
# Copyright (c) 2025 Tim Schrader <tim.schrader92@gmail.com>
# SPDX-License-Identifier: Apache-2.0

# zephyr-keep-sorted-start
source "drivers/sensor/amd/sb_tsi/Kconfig"
# zephyr-keep-sorted-stop
```

## drivers/sensor/amd/sb_tsi/Kconfig
```kconfig
# SB-TSI configuration options

# Copyright (c) 2023 Google LLC
# Copyright The Zephyr Project Contributors
# SPDX-License-Identifier: Apache-2.0

menuconfig AMD_SB_TSI
	bool "SB TSI (AMD) sideband temperature sensor interface"
	default y
	depends on DT_HAS_AMD_SB_TSI_ENABLED
	select I2C
	help
	  Enable the driver for SB Temperature Sensor Interface. This
	  is an I2C temperature sensor on AMD SoCs.

config EMUL_AMD_SB_TSI
	bool "Emulator"
	default y
	depends on AMD_SB_TSI
	depends on EMUL
	help
	  Enable the hardware emulator for the AMD SB-TSI.
```

## drivers/sensor/ams/ams_as5600/Kconfig
```kconfig
# AS5600 Angular position sensor configuration option

# Copyright (c) 2022, Felipe Neves.
# Copyright The Zephyr Project Contributors
# SPDX-License-Identifier: Apache-2.0

config AMS_AS5600
	bool "AS5600 (AMS) angular position sensor driver"
	default y
	depends on DT_HAS_AMS_AS5600_ENABLED
	select I2C
	help
	  Enable driver for AS5600 Angular position sensor.
```

## drivers/sensor/ams/tcs3400/Kconfig
```kconfig
# Copyright 2023 Google LLC
# Copyright The Zephyr Project Contributors
# SPDX-License-Identifier: Apache-2.0

config TCS3400
	bool "TCS3400 (AMS) color sensor driver"
	default y
	depends on DT_HAS_AMS_TCS3400_ENABLED
	select I2C
	help
	  Enable driver for TCS3400 sensors.
```

## drivers/sensor/ams/tsl2561/Kconfig
```kconfig
# Copyright (c) 2023 Gustavo Silva
# Copyright The Zephyr Project Contributors
# SPDX-License-Identifier: Apache-2.0

config TSL2561
	bool "TSL2561 (AMS) light sensor driver"
	default y
	depends on DT_HAS_AMS_TSL2561_ENABLED
	select I2C
	help
	  Enable driver for TSL2561 sensor.
```

## drivers/sensor/aosong/ags10/Kconfig
```kconfig
# Copyright (c) 2023 Balthazar Deliers
# Copyright The Zephyr Project Contributors
# SPDX-License-Identifier: Apache-2.0

# AOSONG AGS10 TVOC sensor driver options.

config AGS10
	bool "AGS10 (Aosong) TVOC sensor driver"
	default y
	depends on DT_HAS_AOSONG_AGS10_ENABLED
	select I2C
	help
	  Enable AOSONG AGS10 TVOC sensor driver.
```
