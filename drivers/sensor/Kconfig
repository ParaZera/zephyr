## drivers/sensor/atmel/qdec_sam/Kconfig
```kconfig
# Atmel SAM MCU family Quadrature Decoder (TC) driver configuration options
#
# Copyright (c) 2021, Piotr Mienkowski
# SPDX-License-Identifier: Apache-2.0
#

menuconfig QDEC_SAM
	bool "SAM TC QDEC (Atmel) quadrature decoder sensor driver"
	default y
	depends on DT_HAS_ATMEL_SAM_TC_QDEC_ENABLED
	depends on SOC_FAMILY_ATMEL_SAM
	select PINCTRL
	help
	  Atmel SAM MCU family Quadrature Decoder (TC) driver.
```

## drivers/sensor/avago/Kconfig
```kconfig
# Copyright (c) 2025 Tim Schrader <tim.schrader92@gmail.com>
# SPDX-License-Identifier: Apache-2.0

# zephyr-keep-sorted-start
source "drivers/sensor/avago/apds9253/Kconfig"
source "drivers/sensor/avago/apds9306/Kconfig"
source "drivers/sensor/avago/apds9960/Kconfig"
# zephyr-keep-sorted-stop
```

## drivers/sensor/avago/apds9306/Kconfig
```kconfig
# SPDX-License-Identifier: Apache-2.0
# Copyright (c) 2024 Daniel Kampert
# Author: Daniel Kampert <DanielKampert@Kampis-Elektroecke.de>

config APDS9306
	bool "APDS9306 (Avago) ambient light sensor driver"
	default y
	depends on DT_HAS_AVAGO_APDS9306_ENABLED
	select I2C
	help
	  Enable the driver for the APDS9306 digital light sensor.
```

## drivers/sensor/bosch/bmp581/Kconfig
```kconfig
#
# Copyright (c) 2022 Badgerd Technologies B.V and its affiliates
# Copyright (c) 2025 Croxel, Inc.
# Copyright (c) 2025 CogniPilot Foundation
# Copyright The Zephyr Project Contributors
#
# SPDX-License-Identifier: Apache-2.0
#

menuconfig BMP581
	bool "BMP581 (Bosch) barometric pressure sensor driver"
	depends on DT_HAS_BOSCH_BMP581_ENABLED
	select I2C
	select I2C_RTIO
	default y

if BMP581

config BMP581_STREAM
	bool "Streaming mode"
	default y
	depends on SENSOR_ASYNC_API
	depends on GPIO
	depends on $(dt_compat_any_has_prop,$(DT_COMPAT_BOSCH_BMP581),int-gpios)

endif # BMP581
```

## drivers/sensor/dfrobot/Kconfig
```kconfig
# Copyright (c) 2025 Tim Schrader <tim.schrader92@gmail.com>
# SPDX-License-Identifier: Apache-2.0

# zephyr-keep-sorted-start
source "drivers/sensor/dfrobot/a01nyub/Kconfig"
# zephyr-keep-sorted-stop
```

## drivers/sensor/ene/Kconfig
```kconfig
# Copyright (c) 2025 Tim Schrader <tim.schrader92@gmail.com>
# SPDX-License-Identifier: Apache-2.0

# zephyr-keep-sorted-start
source "drivers/sensor/ene/tach_kb1200/Kconfig"
# zephyr-keep-sorted-stop
```

## drivers/sensor/espressif/esp32_temp/Kconfig
```kconfig
# Copyright (c) 2022 Espressif Systems (Shanghai) Co., Ltd.
# Copyright The Zephyr Project Contributors
# SPDX-License-Identifier: Apache-2.0

config ESP32_TEMP
	bool "ESP32-Temp (Espressif) temperature sensor driver"
	default y
	depends on DT_HAS_ESPRESSIF_ESP32_TEMP_ENABLED
	depends on !SOC_SERIES_ESP32
	help
	  Enable driver for temperature sensor on certain ESP targets.
```

## drivers/sensor/espressif/pcnt_esp32/Kconfig
```kconfig
# ESP32 Pulse Counter configuration

# Copyright (c) 2022 Espressif Systems (Shanghai) Co., Ltd.
# Copyright The Zephyr Project Contributors
# SPDX-License-Identifier: Apache-2.0

menuconfig PCNT_ESP32
	bool "PCNT_ESP32 (Espressif) pulse counter sensor driver"
	default y
	depends on DT_HAS_ESPRESSIF_ESP32_PCNT_ENABLED
	help
	  This option enables the PCNT driver for ESP32 family of
	  processors.

if PCNT_ESP32

config PCNT_ESP32_TRIGGER
	bool "Trigger support"
	default y
	help
	  Enable trigger support for the PCNT.

endif # PCNT_ESP32
```

## drivers/sensor/everlight/als_pt19/Kconfig
```kconfig
# Copyright (c) 2025 Dipak Shetty <shetty.dipak@gmx.com>
# Copyright The Zephyr Project Contributors
# SPDX-License-Identifier: Apache-2.0

config EVERLIGHT_ALS_PT19
	bool "ALS-PT19 (Everlight) ambient light sensor driver"
	default y
	depends on DT_HAS_EVERLIGHT_ALS_PT19_ENABLED
	select ADC
	help
	  Enable support for the Everlight ALS-PT19 ambient light sensor.
```

## drivers/sensor/festo/Kconfig
```kconfig
# Copyright (c) 2025 Tim Schrader <tim.schrader92@gmail.com>
# SPDX-License-Identifier: Apache-2.0

# zephyr-keep-sorted-start
source "drivers/sensor/festo/veaa_x_3/Kconfig"
# zephyr-keep-sorted-stop
```

## drivers/sensor/fintek/Kconfig
```kconfig
# Copyright (c) 2025 Tim Schrader <tim.schrader92@gmail.com>
# SPDX-License-Identifier: Apache-2.0

# zephyr-keep-sorted-start
source "drivers/sensor/fintek/f75303/Kconfig"
# zephyr-keep-sorted-stop
```

## drivers/sensor/generic/Kconfig
```kconfig
# Copyright (c) 2025 Tim Schrader <tim.schrader92@gmail.com>
# SPDX-License-Identifier: Apache-2.0

# zephyr-keep-sorted-start
source "drivers/sensor/generic/current_amp/Kconfig"
source "drivers/sensor/generic/hc_sr04/Kconfig"
source "drivers/sensor/generic/lm35/Kconfig"
source "drivers/sensor/generic/lm75/Kconfig"
source "drivers/sensor/generic/lm77/Kconfig"
source "drivers/sensor/generic/ntc_thermistor/Kconfig"
source "drivers/sensor/generic/voltage_divider/Kconfig"
# zephyr-keep-sorted-stop
```

## drivers/sensor/generic/voltage_divider/Kconfig
```kconfig
# Voltage sensor driver
#
# Copyright (c) 2023 FTP Technologies
#
# SPDX-License-Identifier: Apache-2.0

config VOLTAGE_DIVIDER
	bool "Voltage divider (Generic) sensor driver"
	default y
	depends on DT_HAS_VOLTAGE_DIVIDER_ENABLED
	select ADC
	help
	  Enable voltage sensor driver.
```
