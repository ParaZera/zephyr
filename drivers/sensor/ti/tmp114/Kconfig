## drivers/sensor/ti/tmp114/Kconfig
```kconfig
# TMP114 temperature sensor configuration options

# Copyright (c) 2024 Fredrik Gihl
# Copyright The Zephyr Project Contributors
# SPDX-License-Identifier: Apache-2.0

config TMP114
	bool "TMP114 (TI) temperature sensor driver"
	default y
	depends on DT_HAS_TI_TMP114_ENABLED
	select I2C
	help
	  Enable driver for TMP114 temperature sensors.
```

## drivers/sensor/ti/tmp11x/Kconfig
```kconfig
# TMP11X temperature sensor configuration options

# Copyright (c) 2019 Centaur Analytics, Inc
# Copyright The Zephyr Project Contributors
# SPDX-License-Identifier: Apache-2.0

menuconfig TMP11X
	bool "TMP116, TMP117, TMP119 (TI) temperature sensor driver"
	default y
	depends on DT_HAS_TI_TMP11X_ENABLED
	select I2C
	help
	  Enable driver for TMP116, TMP117 and TMP119 temperature sensors.

if TMP11X

module = TMP11X
thread_priority = 10
thread_stack_size = 1024
source "drivers/sensor/Kconfig.trigger_template"

endif
```

## drivers/sensor/vishay/veml6031/Kconfig
```kconfig
# Copyright (c) 2025 Andreas Klinger
# Copyright The Zephyr Project Contributors
# SPDX-License-Identifier: Apache-2.0

# Vishay VEML6031 ambient light sensor driver options.

config VEML6031
	bool "VEML6031 (Vishay) ambient light sensor driver"
	default y
	depends on DT_HAS_VISHAY_VEML6031_ENABLED
	select I2C
	help
	  Enable Vishay VEML6031 ambient light sensor driver.
```

## drivers/sensor/vishay/veml7700/Kconfig
```kconfig
# Copyright (c) 2023 Andreas Kilian
# Copyright The Zephyr Project Contributors
# SPDX-License-Identifier: Apache-2.0

# Vishay VEML7700 ambient light sensor driver options.

config VEML7700
	bool "VEML7700 (Vishay) ambient light sensor driver"
	default y
	depends on DT_HAS_VISHAY_VEML7700_ENABLED
	select I2C
	help
	  Enable Vishay VEML7700 ambient light sensor driver.
```

## drivers/sensor/winsen/Kconfig
```kconfig
# Copyright (c) 2025 Tim Schrader <tim.schrader92@gmail.com>
# SPDX-License-Identifier: Apache-2.0

# zephyr-keep-sorted-start
source "drivers/sensor/winsen/mhz19b/Kconfig"
# zephyr-keep-sorted-stop
```

## drivers/sensor/wsen/wsen_hids_2525020210002/Kconfig
```kconfig
# Copyright (c) 2024 Würth Elektronik eiSos GmbH & Co. KG
# Copyright The Zephyr Project Contributors
# SPDX-License-Identifier: Apache-2.0

config WSEN_HIDS_2525020210002
	bool "WSEN-HIDS-2525020210002 (WE) humidity sensor driver"
	default y
	depends on DT_HAS_WE_WSEN_HIDS_2525020210002_ENABLED
	select I2C
	select HAS_WESENSORS
	help
	  Enable driver for the WSEN-HIDS-2525020210002 I2C-based humidity sensor.
```
