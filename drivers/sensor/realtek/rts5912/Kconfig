## drivers/sensor/realtek/rts5912/Kconfig
```kconfig
# Copyright (c) 2025, Realtek, SIBG-SD7
# Copyright The Zephyr Project Contributors
# SPDX-License-Identifier: Apache-2.0

config TACH_RTS5912
	bool "RTS5912 (Realtek) tachometer sensor driver"
	default y
	depends on DT_HAS_REALTEK_RTS5912_TACH_ENABLED
	help
	  Enable the Realtek RTS5912 tachometer sensor.
```

## drivers/sensor/renesas/hs300x/Kconfig
```kconfig
# Renesas HS300x temperature and humidity sensor configuration options

# Copyright (c) 2023 Ian Morris
# Copyright The Zephyr Project Contributors
# SPDX-License-Identifier: Apache-2.0

config HS300X
	bool "HS300x (Renesas) temperature, humidity sensor driver"
	default y
	depends on DT_HAS_RENESAS_HS300X_ENABLED
	select I2C
	help
	  Enable driver for HS300x temperature and humidity sensors.
```

## drivers/sensor/renesas/hs400x/Kconfig
```kconfig
# HS400X temperature and humidity sensor

# Copyright (c) 2024 Renesas Electronics Corporation
# Copyright The Zephyr Project Contributors
# SPDX-License-Identifier: Apache-2.0

menuconfig HS400x
	bool "HS400X (Renesas) temperature, humidity sensor driver"
	default y
	depends on DT_HAS_RENESAS_HS400X_ENABLED
	help
	  Enable driver for HS400x temperature and humidity sensors.

if HS400x

config HS400X_CRC
	bool "HS400X CRC check"
	select CRC
	help
	 Verify the checksum byte from measurements

endif # HS400x
```

## drivers/sensor/rohm/bd8lb600fs/Kconfig
```kconfig
# Copyright (c) 2024 SILA Embedded Solutions GmbH
# Copyright The Zephyr Project Contributors
# SPDX-License-Identifier: Apache-2.0

config BD8LB600FS_DIAGNOSTICS
	bool "BD8LB600FS (Rohm) diagnostics sensor driver"
	default y
	depends on DT_HAS_ROHM_BD8LB600FS_DIAGNOSTICS_ENABLED
	select MFD
	help
	  Enable driver for the open load detection, over current
	  protection and thermal shutdown sensors of the low side
	  switch BD8LB600FS.
```

## drivers/sensor/sbs/gauge/Kconfig
```kconfig
# Copyright (c) 2021 Leica Geosystems AG
# SPDX-License-Identifier: Apache-2.0

menuconfig SBS_GAUGE
	bool "Fuel Gauge (SBS) smart battery fuel gauge sensor driver"
	default y
	depends on DT_HAS_SBS_SBS_GAUGE_ENABLED
	select I2C
	help
	  Enable I2C-based/SMBus-based driver for a Smart Battery Fuel Gauge.

# Maintain access to emul_sbs_gauge.
source "drivers/fuel_gauge/sbs_gauge/Kconfig.emul_sbs_gauge"
```

## drivers/sensor/seeed/grove/Kconfig
```kconfig
# Drivers configuration options for SeeedStudio Grove Devices

# Copyright (c) 2015 Intel Corporation
# Copyright The Zephyr Project Contributors
# SPDX-License-Identifier: Apache-2.0

config GROVE_SENSORS
	bool
	default y
	depends on DT_HAS_SEEED_GROVE_LIGHT_ENABLED || DT_HAS_SEEED_GROVE_TEMPERATURE_ENABLED
	help
	  Enable Seeed Grove sensors support.

config GROVE_LIGHT_SENSOR
	bool "Grove-Light (Seeed) light sensor driver"
	default y
	depends on DT_HAS_SEEED_GROVE_LIGHT_ENABLED
	select ADC
	help
	  Setting this value will enable driver support for the Grove Light
	  Sensor.

config GROVE_TEMPERATURE_SENSOR
	bool "Grove-Temp (Seeed) temperature sensor driver"
	default y
	depends on DT_HAS_SEEED_GROVE_TEMPERATURE_ENABLED
	select ADC
	help
	  Setting this value will enable driver support for the Grove
	  Temperature Sensor.
```

## drivers/sensor/seeed/hm330x/Kconfig
```kconfig
# Seeed Studio HM330x dust particle sensor configuration options

# Copyright (c) 2023 Benjamin Cabé <benjamin@zephyrproject.org>
# Copyright The Zephyr Project Contributors
# SPDX-License-Identifier: Apache-2.0

config HM330X
	bool "HM330X (Seeed) dust particle sensor driver"
	default y
	depends on DT_HAS_SEEED_HM330X_ENABLED
	select I2C
	help
	  Enable driver for the HM330X dust particle sensor.
```

## drivers/sensor/sensirion/scd4x/Kconfig
```kconfig
# Drivers configuration options for Sensirion SCD4x

# Copyright (c) 2024 Jan Fäh
# Copyright The Zephyr Project Contributors
# SPDX-License-Identifier: Apache-2.0

config SCD4X
	bool "SCD4X (Sensirion) carbon dioxide sensor driver"
	default y
	depends on DT_HAS_SENSIRION_SCD41_ENABLED || DT_HAS_SENSIRION_SCD40_ENABLED
	select I2C
	select CRC
	help
	  Enable driver for the Sensirion SCD4x carbon dioxide sensors.
```

## drivers/sensor/sensirion/sgp40/Kconfig
```kconfig
# SGP40 multipixel gas sensor configuration options

# Copyright (c) 2021 Leonard Pollak
# Copyright The Zephyr Project Contributors
# SPDX-License-Identifier: Apache-2.0

config SGP40
	bool "SGP40 (Sensirion) multipixel gas sensor driver"
	default y
	depends on DT_HAS_SENSIRION_SGP40_ENABLED
	select I2C
	select CRC
	help
	  Enable driver for SGP40 Multipixel Gas Sensor.
```

## drivers/sensor/sensirion/sht4x/Kconfig
```kconfig
# SHT4x temperature and humidity sensor configuration options

# Copyright (c) 2021 Leonard Pollak
# Copyright The Zephyr Project Contributors
# SPDX-License-Identifier: Apache-2.0

config SHT4X
	bool "SHT4X (Sensirion) temperature and humidity sensor driver"
	default y
	depends on DT_HAS_SENSIRION_SHT4X_ENABLED
	select I2C
	select CRC
	help
	  Enable driver for SHT4x temperature and humidity sensors.
```

## drivers/sensor/sensirion/shtcx/Kconfig
```kconfig
# SHTCX temperature and humidity sensor configuration options

# Copyright (c) 2021 Thomas Stranger
# Copyright The Zephyr Project Contributors
# SPDX-License-Identifier: Apache-2.0

config SHTCX
	bool "SHTCX (Sensirion) temperature and humidity sensor driver"
	default y
	depends on DT_HAS_SENSIRION_SHTCX_ENABLED
	select I2C
	select CRC
	help
	  Enable driver for SHTC1 and SHTC3 temperature and humidity sensors.
```

## drivers/sensor/sensirion/sts4x/Kconfig
```kconfig
# Drivers configuration options for Sensirion STS4x

# Copyright (c) 2024 Jan Fäh
# Copyright The Zephyr Project Contributors
# SPDX-License-Identifier: Apache-2.0

config STS4X
	bool "STS4X (Sensirion) temperature sensor driver"
	default y
	depends on DT_HAS_SENSIRION_STS4X_ENABLED
	select I2C
	select CRC
	help
	  Enable driver for the Sensirion STS4x temperature sensors.
```

## drivers/sensor/silabs/si7060/Kconfig
```kconfig
# SI7060 temperature sensor configuration options

# Copyright (c) 2019 Actinius
# Copyright The Zephyr Project Contributors
# SPDX-License-Identifier: Apache-2.0

config SI7060
	bool "SI7060 (Silabs) temperature sensor driver"
	default y
	depends on DT_HAS_SILABS_SI7060_ENABLED
	select I2C
	help
	  Enable driver for SI7060 temperature sensors.
```

## drivers/sensor/silabs/si7210/Kconfig
```kconfig
# Si7210 Hall Effect Magnetic Position and Temperature Sensor configuration options
# Copyright (c) 2019 Actinius
# Copyright The Zephyr Project Contributors
# SPDX-License-Identifier: Apache-2.0

config SI7210
	bool "SI7210 (Silabs) hall effect magnetic position and temperature sensor driver"
	default y
	depends on DT_HAS_SILABS_SI7210_ENABLED
	select I2C
	help
	  Enable driver for Si7210 Hall Effect Magnetic Position and Temperature Sensor.
```

## drivers/sensor/st/lsm9ds1/Kconfig
```kconfig
# Copyright (c) 2024 Bootlin
# Copyright The Zephyr Project Contributors
# SPDX-License-Identifier: Apache-2.0

menuconfig LSM9DS1
	bool "LSM9DS1 (ST) accelerometer, temperature sensor driver"
	default y
	depends on DT_HAS_ST_LSM9DS1_ENABLED
	select I2C
	select HAS_STMEMSC
	select USE_STDC_LSM9DS1

if LSM9DS1

config LSM9DS1_ENABLE_TEMP
	bool "LSM9DS1 Temperature sensor"
	help
	  Enable/disable temperature

endif #LSM9DS1
```

## drivers/sensor/st/lsm9ds1_mag/Kconfig
```kconfig
# Copyright (c) 2024 Bootlin
# Copyright The Zephyr Project Contributors
# SPDX-License-Identifier: Apache-2.0

config LSM9DS1_MAG
	bool "LSM9DS1 (ST) magnetometer sensor driver"
	default y
	depends on DT_HAS_ST_LSM9DS1_MAG_ENABLED
	select I2C
	select HAS_STMEMSC
	select USE_STDC_LSM9DS1
```

## drivers/sensor/st/qdec_stm32/Kconfig
```kconfig
# Copyright (c) 2022, Valerio Setti <vsetti@baylibre.com>
# Copyright The Zephyr Project Contributors
# SPDX-License-Identifier: Apache-2.0
#

config QDEC_STM32
	bool "STM32-QDEC (ST) quadrature decoder sensor driver"
	default y
	depends on DT_HAS_ST_STM32_QDEC_ENABLED
	select PINCTRL
	select USE_STM32_LL_TIM
	help
	  STM32 family Quadrature Decoder driver.
```

## drivers/sensor/st/stm32_temp/Kconfig
```kconfig
# STM32 temperature sensor configuration options

# Copyright (c) 2021 Eug Krashtan
# Copyright The Zephyr Project Contributors
# SPDX-License-Identifier: Apache-2.0

config STM32_TEMP
	bool "STM32 (ST) temperature sensor driver"
	default y
	depends on SOC_FAMILY_STM32
	depends on DT_HAS_ST_STM32_ADC_ENABLED
	depends on DT_HAS_ST_STM32_TEMP_ENABLED || \
		   DT_HAS_ST_STM32_TEMP_CAL_ENABLED || \
		   DT_HAS_ST_STM32C0_TEMP_CAL_ENABLED
	select ADC
	help
	  Enable driver for STM32 temperature sensor.
```

## drivers/sensor/tdk/icp101xx/Kconfig
```kconfig
# Copyright (c) 2024 TDK Invensense
# Copyright The Zephyr Project Contributors

# ICP101xx High Accuracy, Low Power, Barometric Pressure and Temperature Sensor option

# SPDX-License-Identifier: Apache-2.0
config ICP101XX
	bool "ICP101XX (TDK) barometric pressure and temperature sensor driver"
	default y
	depends on DT_HAS_INVENSENSE_ICP101XX_ENABLED
	select I2C
	select USE_EMD_ICP101XX
	help
		Enable driver for ICP101XX barometric pressure/temperature sensors.
```

## drivers/sensor/ti/ina219/Kconfig
```kconfig
# INA219 Bidirectional Current/Power Monitor

# Copyright (c) 2021 Leonard Pollak
# Copyright The Zephyr Project Contributors
# SPDX-License-Identifier: Apache-2.0

config INA219
	bool "INA219 (TI) current/power monitor sensor driver"
	default y
	depends on DT_HAS_TI_INA219_ENABLED
	select I2C
	help
	  Enable driver for INA219 Bidirectional Current/Power Monitor.
```

## drivers/sensor/ti/ina226/Kconfig
```kconfig
# INA226 Bidirectional Current/Power Monitor

# Copyright 2024 NXP
# Copyright The Zephyr Project Contributors
# SPDX-License-Identifier: Apache-2.0

menuconfig INA226
	bool "INA226 (TI) current/power monitor sensor driver"
	default y
	depends on DT_HAS_TI_INA226_ENABLED
	select I2C
	help
	  Enable driver for INA226 Bidirectional Current/Power Monitor.

if INA226

config INA226_VSHUNT
	bool "INA226 VShunt Measurement Enable"
	depends on DT_HAS_TI_INA226_ENABLED
	help
	  Enable shunt voltage measurement for INA226.

	  This is the actual shunt voltage measured which is scaled within the
	  INA226 based upon the SHUNT_CAL register. This value is useful for
	  determining the measurement noise or debugging the SHUNT_CAL value.

	  Note that enabling this option requires an extra I2C read when the
	  SENSOR_CHAN_ALL is selected. Hence, only enable this option if the
	  shunt voltage measurement is required.

endif # INA226
```

## drivers/sensor/ti/ina3221/Kconfig
```kconfig
# INA3221 Bidirectional Current/Power Monitor

# Copyright (c) 2023 Nordic Semiconductor ASA
# Copyright The Zephyr Project Contributors
# SPDX-License-Identifier: Apache-2.0

config INA3221
	bool "INA3221 (TI) triple-channel current/power monitor sensor driver"
	default y
	depends on DT_HAS_TI_INA3221_ENABLED
	select I2C
	help
	  Enable driver for INA3221 Triple-Channel Current/Power Monitor.
```

## drivers/sensor/ti/lm95234/Kconfig
```kconfig
# LM95234 temperature sensor config

# Copyright (c) 2024 Calian Advanced Technologies
# Copyright The Zephyr Project Contributors
# SPDX-License-Identifier: Apache-2.0

config LM95234
	bool "LM95234 (TI) temperature sensor driver"
	default y
	depends on DT_HAS_NATIONAL_LM95234_ENABLED
	select I2C
	help
	  Enable the driver for the LM95234 Quad Remote Diode and Local
	  Temperature Sensor with SMBus Interface.
```

## drivers/sensor/ti/ti_hdc/Kconfig
```kconfig
# TI_HDC temperature and humidity sensor configuration options

# Copyright (c) 2016 Intel Corporation
# Copyright The Zephyr Project Contributors
# SPDX-License-Identifier: Apache-2.0

config TI_HDC
	bool "TI-HDC (TI) temperature and humidity (e.g. HDC1008) sensor driver"
	default y
	depends on DT_HAS_TI_HDC_ENABLED
	select I2C
	help
	  Enable driver for TI temperature and humidity sensors.
```

## drivers/sensor/ti/ti_hdc20xx/Kconfig
```kconfig
# TI_HDC20XX temperature and humidity sensor configuration options

# Copyright (c) 2021 Aurelien Jarno
# Copyright The Zephyr Project Contributors
# SPDX-License-Identifier: Apache-2.0

config TI_HDC20XX
	bool "HDC20XX (TI) temperature and humidity sensor driver"
	default y
	depends on DT_HAS_TI_HDC2010_ENABLED || DT_HAS_TI_HDC2021_ENABLED || \
		   DT_HAS_TI_HDC2022_ENABLED || DT_HAS_TI_HDC2080_ENABLED
	select I2C
	help
	  Enable driver for TI HDC20XX temperature and humidity sensors
	  (e.g. HDC2010, HDC2021, HDC2022, HDC2080).
```
